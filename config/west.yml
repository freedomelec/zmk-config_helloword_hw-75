## config/west.yml
```yaml
manifest:
  projects:
    - name: zmk
      url: https://github.com/xingrz/zmk.git
      revision: zmkx-rel-20241223
      import: app/west.yml
  self:
    path: config
```
